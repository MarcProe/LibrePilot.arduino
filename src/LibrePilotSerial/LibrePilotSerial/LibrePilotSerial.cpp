#include "Arduino.h"
#include "LibrePilotSerial.h"

byte _CRC_TABLE[] = {
        0x00, 0x07, 0x0e, 0x09, 0x1c, 0x1b, 0x12, 0x15, 0x38, 0x3f, 0x36, 0x31, 0x24, 0x23, 0x2a, 0x2d,
        0x70, 0x77, 0x7e, 0x79, 0x6c, 0x6b, 0x62, 0x65, 0x48, 0x4f, 0x46, 0x41, 0x54, 0x53, 0x5a, 0x5d,
        0xe0, 0xe7, 0xee, 0xe9, 0xfc, 0xfb, 0xf2, 0xf5, 0xd8, 0xdf, 0xd6, 0xd1, 0xc4, 0xc3, 0xca, 0xcd,
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        0xde, 0xd9, 0xd0, 0xd7, 0xc2, 0xc5, 0xcc, 0xcb, 0xe6, 0xe1, 0xe8, 0xef, 0xfa, 0xfd, 0xf4, 0xf3
};
    
LibrePilotSerial::LibrePilotSerial(SoftwareSerial* ser) {
  serial = ser;
}

void LibrePilotSerial::request(unsigned long objId) {
  _pBuf[0] = 0x3c; //sync
  _pBuf[1] = 0x21; //msgtype (0x21 = request)
  _pBuf[2] = 0x0a; //len
  _pBuf[3] = 0x00; //len
  _pBuf[4] = (objId >> (8*0)) & 0xff; 
  _pBuf[5] = (objId >> (8*1)) & 0xff;
  _pBuf[6] = (objId >> (8*2)) & 0xff;
  _pBuf[7] = (objId >> (8*3)) & 0xff;
  _pBuf[8] = 0x00; //iid
  _pBuf[9] = 0x00; //iid
  _pBuf[10] = _crc(10); //crc

  serial->write(_pBuf, 11);
}

void LibrePilotSerial::send(unsigned long objId, byte* data, int length) {
  byte header[10];
  header[0] = 0x3c; //sync
  header[1] = 0x20; //msgtype (0x20 = send)
  
  int pLen  = length + 10;  
  header[2] = (pLen >> (8*0)) & 0xff;
  header[3] = (pLen >> (8*1)) & 0xff;
  
  header[4] = (objId >> (8*0)) & 0xff; 
  header[5] = (objId >> (8*1)) & 0xff;
  header[6] = (objId >> (8*2)) & 0xff;
  header[7] = (objId >> (8*3)) & 0xff;
  header[8] = 0x00; //iid
  header[9] = 0x00; //iid

  byte crc = _crc(header, data, length);

  serial->write(header, 10);
  serial->write(data, length);
  serial->write(crc);   
}

boolean LibrePilotSerial::receive(unsigned long objId, byte *ret, unsigned int timeout = 100) {
  boolean loop = 1;
  unsigned long time = millis();
  
  while(loop) {
    if (serial->available()) {    

      loop = millis() <= time + timeout;  //loop as long as start + timeout lower tham current time
    
      _pBuf[0] = serial->read();;
      if (_pBuf[0] == 0){
        //NOOP
      } else if(_pBuf[0] != 0x3c) {
        //Serial.print(sync, HEX);
        //Serial.println(" Bad Byte ");
      } else {
        
        _pBuf[1] = serial->read(); //msgtype
        
        _pBuf[2] = serial->read();
        _pBuf[3] = serial->read();
        
        unsigned int len = (unsigned int) _pBuf[2] | (unsigned int) _pBuf[3] << 8;
        
        if(len < 10 || len > 265) {
          
        } else {
            
          unsigned long oid0 = serial->read();
          _pBuf[4] = oid0;
          unsigned long oid1 = serial->read();
          _pBuf[5] = oid1;
          unsigned long oid2 = serial->read();
          _pBuf[6] = oid2;
          unsigned long oid3 = serial->read();
          _pBuf[7] = oid3;
    
          unsigned long oid = oid0 + oid1 * 256 + oid2 * 65536 + oid3 * 16777216;
    
          if(oid != objId) {
            //Serial.print(oid,HEX);
            //Serial.print(".");
            //Serial.println(objId,HEX);
          } else {
            loop = 0;
               
            int iid0 = serial->read();
            _pBuf[8] = iid0;
            int iid1 = serial->read();
            _pBuf[9] = iid1;
    
            unsigned int iid = iid0 + iid1 * 256;             
    
            int datalen = len - 10;;
  
            int j;          
            for (j = 10; j < len; j++) {
              _pBuf[j] = serial->read();
              ret[j-10] = _pBuf[j];
            }
    
            byte crc = serial->read();

            byte ccrc = _crc(len);
             
            return crc == ccrc;
            
          }        
        }    
      }    
    } else {
      loop = 0;
    }
  }
  return false;
}

byte LibrePilotSerial::_crc(int len) {
  byte ccrc = 0;
  for (unsigned int k = 0; k < len; k++) {
      ccrc = _CRC_TABLE[((byte) (ccrc ^ _pBuf[k])) & 0xFF];
  }
  return (ccrc & 0xFF);
}


byte LibrePilotSerial::_crc(byte* header, byte* data, int len) {
  byte ccrc = 0;
  for (unsigned int k = 0; k < 10; k++) {
      ccrc = _CRC_TABLE[((byte) (ccrc ^ header[k])) & 0xFF];
  }
  for (unsigned int k = 0; k < len; k++) {
      ccrc = _CRC_TABLE[((byte) (ccrc ^ data[k])) & 0xFF];
  }
  return (ccrc & 0xFF);
}


